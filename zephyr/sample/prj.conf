## CMakeLists.txt
```
cmake_minimum_required(VERSION 3.13.1)

set(BOARD nucleo_h745zi_q/stm32h745xx/m7)
set(ZEPHYR_EXTRA_MODULES ${CMAKE_CURRENT_LIST_DIR}/../..)

find_package(Zephyr REQUIRED HINTS $ENV{ZEPHYR_BASE})
project(soem_zephyr)

FILE(GLOB app_sources src/*.c)
target_sources(app PRIVATE ${app_sources})
```

## prj.conf
```kconfig
CONFIG_SOEM=y

CONFIG_SYSTEM_WORKQUEUE_STACK_SIZE=2048

CONFIG_GPIO=y
CONFIG_LOG=y
CONFIG_LOG_PROCESS_THREAD_SLEEP_MS=100
CONFIG_MAIN_STACK_SIZE=10240

CONFIG_REBOOT=y

#CONFIG_POSIX_API=y
#CONFIG_POSIX_RAW_SOCKETS=y

# Debugging

CONFIG_SHELL=y
CONFIG_THREAD_RUNTIME_STATS=y
CONFIG_THREAD_RUNTIME_STATS_USE_TIMING_FUNCTIONS=y

# Network

CONFIG_NETWORKING=y
CONFIG_NET_IPV6=y
CONFIG_NET_IPV4=y
CONFIG_NET_UDP=y
CONFIG_NET_TCP=y
CONFIG_NET_DHCPV4=y
CONFIG_NET_SHELL=y
CONFIG_NET_SOCKETS=y
CONFIG_NET_PKT_RX_COUNT=10
CONFIG_NET_PKT_TX_COUNT=10
CONFIG_NET_BUF_RX_COUNT=30
CONFIG_NET_BUF_TX_COUNT=30
CONFIG_NET_IF_UNICAST_IPV6_ADDR_COUNT=3
CONFIG_NET_IF_MCAST_IPV6_ADDR_COUNT=5
CONFIG_NET_IF_MCAST_IPV4_ADDR_COUNT=2
CONFIG_NET_IF_UNICAST_IPV4_ADDR_COUNT=2
CONFIG_NET_SOCKETS_PACKET=y
CONFIG_NET_CONTEXT_RCVTIMEO=y
CONFIG_NET_CONTEXT_SNDTIMEO=y
```

## src/main.c
```c
#include <zephyr/device.h>
#include <zephyr/net/net_core.h>
#include <zephyr/net/net_if.h>
#include <zephyr/kernel.h>

#include "ethercat.h"
#include "fieldbus.h"

#include <zephyr/logging/log.h>
LOG_MODULE_REGISTER(app);

static struct fieldbus fieldbus;
static uint8_t map[4096];

static uint8_t slave_get(struct fieldbus *fb, int slave_num, int offset)
{
	struct ec_slave *slave;
	uint8_t ret;

	if (slave_num > fb->slavecount) {
		LOG_ERR("invalid slave number: %d", slave_num);
		return 0;
	}

	slave = &fb->slavelist[slave_num];

	if (offset >= slave->Ibytes) {
		LOG_ERR("invalid offset for slave %d (%s): %d",
			slave_num, slave->name, offset);
		return 0;
	}

	k_mutex_lock(&fb->lock, K_FOREVER);
	ret = slave->inputs[offset];
	k_mutex_unlock(&fb->lock);

	return ret;
}

static void slave_set(struct fieldbus *fb, int slave_num, int offset, uint8_t val)
{
	struct ec_slave *slave;

	if (slave_num > fb->slavecount) {
		LOG_ERR("invalid slave number: %d", slave_num);
		return;
	}

	slave = &fb->slavelist[slave_num];

	if (offset >= slave->Obytes) {
		LOG_ERR("invalid offset for slave %d (%s): %d",
			slave_num, slave->name, offset);
		return;
	}

	k_mutex_lock(&fb->lock, K_FOREVER);
	slave->outputs[offset] = val;
	k_mutex_unlock(&fb->lock);
}

static bool fieldbus_dump(struct fieldbus *fb)
{
#if 0
	ec_groupt *grp;
	uint32 n;

	grp = &fb->grouplist[0];

	printk("  O:");
	for (n = 0; n < grp->Obytes; ++n) {
		printk(" %02X", grp->outputs[n]);
	}
	printk("  I:");
	for (n = 0; n < grp->Ibytes; ++n) {
		printk(" %02X", grp->inputs[n]);
	}
	printk("  T: %lld\r", (long long)fb->DCtime);

#endif
	return true;
}

static void ec_loop(void *p1, void *p2, void *p3)
{
	struct fieldbus *fb = p1;
	int wkc, expected_wkc;
	ec_groupt *grp;
	int i = 0;

	grp = &fb->grouplist[0];

	while (!fb->started) {
		k_msleep(100);
	}

	for (;;) {
		wkc = fieldbus_roundtrip(fb);
		expected_wkc = grp->outputsWKC * 2 + grp->inputsWKC;
		if (wkc < expected_wkc) {
			LOG_WRN("WKC wrong: %d expected %d", wkc, expected_wkc);
		}

		if (i % 100 == 0) {
			LOG_INF("iteration %d RTT %dus WKC %d", i, fb->roundtrip_time, wkc);
			fieldbus_dump(fb);
		}
		i++;
		k_msleep(5);
	}
}

#define EC_LOOP_TH_SIZE 1024
K_THREAD_DEFINE(ec_loop_th, EC_LOOP_TH_SIZE,
		ec_loop, &fieldbus, NULL, NULL,
		K_PRIO_COOP(10), 0, 0);

int main(void)
{
	struct net_if *iface;

	k_mutex_init(&fieldbus.lock);

	fieldbus_initialize(&fieldbus);

	iface = net_if_get_default();

	LOG_INF("waiting for interface to be up...");
	for (;;) {
		k_sleep(K_SECONDS(1));
		if (net_if_is_up(iface)) {
			break;
		}
		LOG_INF("still waiting...");
	}

	fieldbus_start(&fieldbus, map);

	fieldbus.started = true;

	uint8_t in = 0;
	uint8_t out = 0;
	for (;;) {
		in = slave_get(&fieldbus, 3, 0);
		LOG_INF("in: %x", in);
		if (in & BIT(2)) {
			out = BIT(1);
		} else {
			out = 0;
		}
		slave_set(&fieldbus, 2, 0, out);
		k_msleep(200);
	}

	k_sleep(K_FOREVER);

	return 0;
}

#ifdef CONFIG_NET_DHCPV4
static int start_dhcp(void)
{
	struct net_if *iface;

	iface = net_if_get_default();
	net_dhcpv4_start(iface);

	return 0;
}

SYS_INIT(start_dhcp, APPLICATION, 95);
#endif
```

## src/fieldbus.c
```c
#include <zephyr/kernel.h>

#include "ethercat.h"
#include "fieldbus.h"

#include <zephyr/logging/log.h>
LOG_MODULE_REGISTER(fieldbus);

void fieldbus_initialize(struct fieldbus *fb)
{
	ecx_contextt *context;

	/* Initialize the ecx_contextt data structure */
	context = &fb->context;
	context->port = &fb->port;
	context->slavelist = fb->slavelist;
	context->slavecount = &fb->slavecount;
	context->maxslave = EC_MAXSLAVE;
	context->grouplist = fb->grouplist;
	context->maxgroup = EC_MAXGROUP;
	context->esibuf = fb->esibuf;
	context->esimap = fb->esimap;
	context->esislave = 0;
	context->elist = &fb->elist;
	context->idxstack = &fb->idxstack;
	context->ecaterror = &fb->ecaterror;
	context->DCtime = &fb->DCtime;
	context->SMcommtype = fb->SMcommtype;
	context->PDOassign = fb->PDOassign;
	context->PDOdesc = fb->PDOdesc;
	context->eepSM = &fb->eepSM;
	context->eepFMMU = &fb->eepFMMU;
	context->FOEhook = NULL;
	context->EOEhook = NULL;
	context->manualstatechange = 0;
}

int fieldbus_roundtrip(struct fieldbus *fb)
{
	ecx_contextt *context;
	ec_timet start, end, diff;
	int wkc;

	context = &fb->context;

	start = osal_current_time();

	k_mutex_lock(&fb->lock, K_FOREVER);
	ecx_send_processdata(context);
	wkc = ecx_receive_processdata(context, EC_TIMEOUTRET);
	k_mutex_unlock(&fb->lock);

	end = osal_current_time();
	osal_time_diff(&start, &end, &diff);
	fb->roundtrip_time = diff.sec * 1000000 + diff.usec;

	return wkc;
}

bool fieldbus_start(struct fieldbus *fb, uint8_t *map)
{
	int ret;
	ecx_contextt *ctx;
	ec_groupt *grp;
	ec_slavet *slave;
	int i;

	ctx = &fb->context;
	grp = &fb->grouplist[0];

	ret = ecx_init(ctx, "");
	LOG_INF("ecx_init: %d", ret);

	ret = ecx_config_init(ctx, FALSE);
	LOG_INF("ecx_config_init: %d", ret);

	LOG_INF("%d slaves found", fb->slavecount);

	ecx_config_map_group(ctx, map, 0);
	LOG_INF("ecx_config_map_group: %dO+%dI bytes from %d segments",
	       grp->Obytes, grp->Ibytes, grp->nsegments);

	for (i = 0; i < fb->slavecount; i++) {
		LOG_INF("%d: %s in: %d out: %d", i,
			fb->slavelist[i+1].name,
			fb->slavelist[i+1].Ibytes,
			fb->slavelist[i+1].Obytes);
	}

	LOG_INF("ecx_configdc");
	ecx_configdc(ctx);

	LOG_INF("ecx_statecheck");
	ecx_statecheck(ctx, 0, EC_STATE_SAFE_OP, EC_TIMEOUTSTATE * 4);

	LOG_INF("fieldbus_roundtrip");
	fieldbus_roundtrip(fb);

	LOG_INF("setting operational state...");
	/* Act on slave 0 (a virtual slave used for broadcasting) */
	slave = &fb->slavelist[0];
	slave->state = EC_STATE_OPERATIONAL;
	ecx_writestate(ctx, 0);
	/* Poll the result ten times before giving up */
	for (i = 0; i < 10; ++i) {
		fieldbus_roundtrip(fb);
		ecx_statecheck(ctx, 0, EC_STATE_OPERATIONAL, EC_TIMEOUTSTATE / 10);
		if (slave->state == EC_STATE_OPERATIONAL) {
			LOG_INF("all slaves are now operational");
			return true;
		}
		LOG_INF(".");
	}
	LOG_WRN("Set OP failed.");

	return false;
}

void fieldbus_stop(struct fieldbus *fb)
{
	ecx_contextt *context;
	ec_slavet *slave;

	context = &fb->context;
	slave = &fb->slavelist[0];

	LOG_INF("ecx_writestate EC_STATE_INIT");
	slave->state = EC_STATE_INIT;
	ecx_writestate(context, 0);

	LOG_INF("close");
	ecx_close(context);
}
```

## src/fieldbus.h
```c
struct fieldbus {
	ecx_contextt	context;
	int		roundtrip_time;
	bool		started;
	struct k_mutex	lock;

	ecx_portt	port;
	ec_slavet	slavelist[EC_MAXSLAVE];
	int		slavecount;
	ec_groupt	grouplist[EC_MAXGROUP];
	uint8		esibuf[EC_MAXEEPBUF];
	uint32		esimap[EC_MAXEEPBITMAP];
	ec_eringt	elist;
	ec_idxstackT	idxstack;
	boolean		ecaterror;
	int64		DCtime;
	ec_SMcommtypet	SMcommtype[EC_MAX_MAPT];
	ec_PDOassignt	PDOassign[EC_MAX_MAPT];
	ec_PDOdesct	PDOdesc[EC_MAX_MAPT];
	ec_eepromSMt	eepSM;
	ec_eepromFMMUt	eepFMMU;
};

void fieldbus_initialize(struct fieldbus *fb);
int fieldbus_roundtrip(struct fieldbus *fb);
bool fieldbus_start(struct fieldbus *fb, uint8_t *map);
void fieldbus_stop(struct fieldbus *fb);
```
